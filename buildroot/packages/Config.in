## buildroot/packages/Config.in
```kconfig
menu "MS42P custom packages"
	source "package/click/Config.in"
	source "package/status/Config.in"
	source "package/configd/Config.in"
	source "package/pmweb/Config.in"
	source "package/findhdr/Config.in"
	source "package/pd690xx/Config.in"
	source "package/fwupdate/Config.in"
	source "package/postmerkos-console/Config.in"
endmenu

source "package/postmerkos-hardware/Config.in"
```

## buildroot/packages/pmweb/Config.in
```kconfig
config BR2_PACKAGE_PMWEB
	bool "pmweb single-origin TLS front"
	depends on !BR2_STATIC_LIBS # mongoose/mbedtls dynamic
	select BR2_PACKAGE_MONGOOSE
	select BR2_PACKAGE_MBEDTLS
	help
	  postmerkOS single-origin TLS front proxy. Terminates HTTPS on :443,
	  serves the static web UI, and reverse-proxies the management WebSocket
	  (path /ws) to configd's plain loopback ws on 127.0.0.1:4001. Redirects
	  :80 to https; serves plain HTTP if no certificate is present.
```

## buildroot/packages/postmerkos-hardware/Config.in
```kconfig
config BR2_PACKAGE_POSTMERKOS_HARDWARE
	bool "postmerkOS hardware policy helpers"
	default y
	select BR2_PACKAGE_CONFIGD
	select BR2_PACKAGE_FWUPDATE
	help
	  Capability-v2 hardware discovery, LED ownership and one-shot PoE
	  boot-prune policy. Reset discovery is read-only until a model-specific
	  input is hardware verified; destructive reset remains disabled.
```

## fwupdate/Config.in
```kconfig
config BR2_PACKAGE_FWUPDATE
	bool "postmerkOS VCore-III firmware updater"
	depends on BR2_USE_MMU
	select BR2_PACKAGE_MTD
	select BR2_PACKAGE_MTD_FLASH_ERASE
	select BR2_PACKAGE_MTD_MKFSJFFS2
	select BR2_PACKAGE_JSON_C
	help
	  Safe in-system updater for the supported VCore-III RedBoot layout.
	  It supports local, HTTP(S), TFTP, SFTP, and framed UART transport,
	  while normal updates modify only SquashFS and the selected JFFS2 policy.

config BR2_PACKAGE_FWUPDATE_CURL
	bool "curl HTTP(S)/SFTP transport support"
	default y
	depends on BR2_PACKAGE_FWUPDATE
	select BR2_PACKAGE_MBEDTLS
	select BR2_PACKAGE_LIBSSH2
	select BR2_PACKAGE_LIBSSH2_MBEDTLS
	select BR2_PACKAGE_LIBCURL
	select BR2_PACKAGE_LIBCURL_CURL
	select BR2_PACKAGE_LIBCURL_EXTRA_PROTOCOLS_FEATURES
	select BR2_PACKAGE_LIBCURL_MBEDTLS
	select BR2_PACKAGE_CA_CERTIFICATES
	help
	  Adds HTTPS certificate verification and SFTP support through curl,
	  mbed TLS and libssh2. Plain HTTP and TFTP can work with BusyBox alone.
```
